/*
 * Partilhado pelas duas metades (incluído em corne_left.overlay e
 * corne_right.overlay — o ZMK só carrega UM .overlay por build).
 *
 * O trackpad está no periférico (direita). Os eventos são enviados para a
 * central (esquerda) através de um dispositivo "zmk,input-split".
 * O listener é declarado aqui (desativado) para que o keymap — compilado nas
 * duas metades — possa referenciar &tps65_listener. Só é ativado na central.
 */

/ {
    split_inputs {
        #address-cells = <1>;
        #size-cells = <0>;

        tps65_split: tps65_split@0 {
            compatible = "zmk,input-split";
            reg = <0>;
        };
    };

    tps65_listener: tps65_listener {
        compatible = "zmk,input-listener";
        status = "disabled";
        device = <&tps65_split>;
    };
};
