/*
 * Partilhado pelas duas metades (incluído em corne_left.overlay e
 * corne_right.overlay — o ZMK só carrega UM .overlay por build).
 *
 * Na direita, o input-split recebe o trackpad (device = <&tps65>).
 * Na esquerda (central), o mesmo nó recebe os eventos por BLE e
 * entrega-os ao listener.
 */

/ {
    split_inputs {
        #address-cells = <1>;
        #size-cells = <0>;

        tps65_split: tps65_split@0 {
            compatible = "zmk,input-split";
            reg = <0>;
        };
    };
};
