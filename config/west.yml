## drivers/input/Kconfig
```kconfig
config INPUT_TPS43
    bool "Azoteq TPS43 I2C Touchpad Input Device"
    default y
    depends on I2C
    depends on INPUT
    help
      Enable driver for Azoteq touchpad input device over I2C interface.
      Supports multitouch gestures, scrolling, clicks and power management.

if INPUT_TPS43

config INPUT_TPS43_INIT_PRIORITY
    int "Init priority"
    default 90
    help
      Device driver initialization priority.

config INPUT_TPS43_INIT_RETRIES
    int "Init retries if the trackpad does not answer at boot"
    default 15

config INPUT_TPS43_INIT_RETRY_MS
    int "Delay between init retries (ms)"
    default 2000

config INPUT_TPS43_RDY_POLL
    bool "Poll the RDY pin as a fallback / debug aid"
    help
      Every INPUT_TPS43_RDY_POLL_MS, read the RDY pin level. Logs every level
      change (INF) and schedules a read if RDY is high, so a missed edge can
      never stall the trackpad. Useful to check whether the MCU actually sees
      the RDY signal.

config INPUT_TPS43_RDY_POLL_MS
    int "RDY poll period (ms)"
    default 100
    depends on INPUT_TPS43_RDY_POLL

endif # ZMK_SENSOR_TPS43

config INPUT_PIM447
    bool "Pimoroni PIM447 trackball"
    default y
    depends on DT_HAS_PIMORONI_PIM447_ENABLED
    depends on INPUT
    select I2C
    help
      Pimoroni Trackball Breakout (PIM447) over I2C.

config INPUT_PIM447_INIT_PRIORITY
    int "PIM447 init priority"
    default 91
    depends on INPUT_PIM447

config PIM447_LED_STRIP
    bool "PIM447 LED as extra pixel of the underglow strip"
    default y
    depends on DT_HAS_PIMORONI_PIM447_LED_STRIP_ENABLED && INPUT_PIM447 && LED_STRIP

config PIM447_LED_STRIP_INIT_PRIORITY
    int "PIM447 LED strip init priority"
    default 92
    depends on PIM447_LED_STRIP
```

## dts/bindings/input/pimoroni,pim447-led-strip.yaml
```yaml
description: |
  Virtual LED strip = an existing LED strip + the PIM447 trackball LED as the last pixel.
  Point `zmk,underglow` at this node so the trackball follows the keyboard RGB.

compatible: "pimoroni,pim447-led-strip"

properties:
  led-strip:
    type: phandle
    required: true
    description: The real LED strip (e.g. &led_strip).
  trackball:
    type: phandle
    required: true
    description: The PIM447 trackball node.
  chain-length:
    type: int
    required: true
    description: Real strip length + 1.
```

## dts/bindings/input/pimoroni,pim447.yaml
```yaml
description: Pimoroni Trackball Breakout (PIM447) — I2C, address 0x0A (0x0B alt.)

compatible: "pimoroni,pim447"

include: i2c-device.yaml

properties:
  int-gpios:
    type: phandle-array
    description: INT pin (active low). Without it the driver polls.
  poll-interval-ms:
    type: int
    default: 15
    description: Poll period when no INT pin is used (or INT setup fails).
  idle-poll-interval-ms:
    type: int
    default: 100
    description: Poll period while the ball is still (polling mode only; saves battery).
  rotation:
    type: int
    default: 0
    enum: [0, 90, 180, 270]
    description: Rotate the ball axes clockwise (degrees) to match how it is mounted. Applies to cursor and scroll.
  noise-threshold:
    type: int
    default: 1
    description: Ball counts needed (within 80 ms) to start moving from rest. 1 = off; 2-3 filter stray counts (jitter).
  smoothing:
    type: int
    default: 0
    description: Cursor smoothing. 0/1 = off; N = each step sends 1/N of the pending movement (higher = smoother, more lag).
  smooth-interval-ms:
    type: int
    default: 8
    description: Time between smoothing steps.
  cursor-multiplier:
    type: int
    default: 6
    description: Base cursor speed (pixels per ball count when moving slowly).
  acceleration:
    type: int
    default: 4
    description: Speed-based acceleration (0 = linear, higher = faster when flicking).
  scroll-divisor:
    type: int
    default: 1
    description: Ball counts per scroll step (higher = slower scroll).
  click-toggles-scroll:
    type: boolean
    description: Ball click toggles cursor/scroll mode instead of sending a mouse button.
  led-feedback:
    type: boolean
    description: Flash the ball LED on mode change (blue = cursor, green = scroll).
  led-brightness:
    type: int
    default: 64
    description: LED brightness for feedback flashes (0-255).
```

## src/Kconfig
```kconfig
config CORNE_TPS65_SCREEN
    bool "Ecrãs OLED personalizados (Corne + TPS65)"
    depends on ZMK_DISPLAY && ZMK_DISPLAY_STATUS_SCREEN_CUSTOM
    default y
    select LV_USE_IMAGE
    select LV_USE_LABEL
    select LV_FONT_UNSCII_8
    select LV_FONT_MONTSERRAT_16
    imply LV_USE_THEME_MONO
    imply ZMK_WPM if ZMK_SPLIT_ROLE_CENTRAL

if CORNE_TPS65_SCREEN

config LV_Z_MEM_POOL_SIZE
    default 8192

endif

config CORNE_TPS65_BOOT_POWER_CYCLE
    bool "Power-cycle VCC peripherals at boot (clean reset of trackpad/trackball/OLED)"
    default y
    depends on ZMK_EXT_POWER

config CORNE_TPS65_BOOT_POWER_OFF_MS
    int "VCC off time at boot (ms)"
    default 300
    depends on CORNE_TPS65_BOOT_POWER_CYCLE

config CORNE_TPS65_BOOT_POWER_SETTLE_MS
    int "Settle time after VCC on (ms)"
    default 50
    depends on CORNE_TPS65_BOOT_POWER_CYCLE
```
